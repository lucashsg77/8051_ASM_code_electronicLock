#include <REG51F380.H>

	STATE_0 EQU 0
	STATE_1 EQU 1
	STATE_2 EQU 2
	STATE_3 EQU 3
	STATE_4 EQU 4
	STATE_5 EQU 5
	STATE_6 EQU 6
	STATE_7 EQU 7
	STATE_8 EQU 8
	STATE_9 EQU 9
	STATE_L EQU 10
	STATE_O EQU 11
	STATE_F	EQU 12
	STATE_B	EQU 13
	
	P_DISP	EQU P2
	K_LOAD  EQU P0.7
	K_SET  	EQU P0.6
	BL_TEN	EQU P1.7
	ALARM	EQU P1.6
	MUL_CLK EQU 50 ; 50 x 10000uS = 500mS
	
	STATE       DATA 30H
	N_STATE     DATA 31H
	DIGIT_1     DATA 32H
	DIGIT_2     DATA 33H
	DIGIT_3     DATA 34H		
	DIGIT_4     DATA 35H
	SEC_DIGIT_1 DATA 36H
	SEC_DIGIT_2 DATA 37H
	SEC_DIGIT_3 DATA 38H		
	SEC_DIGIT_4 DATA 39H	
	
	CSEG AT 0H
	
	MOV PCA0MD, #0
	MOV XBR1, #40H
	SETB K_SET
	SETB K_LOAD
; SETS THE INITIAL PASS_KEY OF THE LOCK AS 4444
-------------------------
|SET_SEC_KEY:			|
|	MOV A, #4h		    |  
|	CALL ENCRYPT		|
|	MOV SEC_DIGIT_1, A	|
|	MOV SEC_DIGIT_2, A	|
|	MOV SEC_DIGIT_3, A	|
|	MOV SEC_DIGIT_4, A	|
-------------------------
	MOV R1, #03H
	MOV R7, #3CH
	MOV R6, #0H
	MOV R5, #03CH
	MOV FLSCL, #090h
   	MOV CLKSEL, #003h
	MOV R0, #MUL_CLK
	MOV TMR2RLL, #LOW(-40000) ; 0C0h  40000 x 0,25uS = 10000uS
	MOV TMR2RLH, #HIGH(-40000) ; 063h
    	MOV TMR2L, #0C0h
    	MOV TMR2H, #063h
	MOV TMR2CN, #004h ; EQUIVALENT TO SETB TR2
	LJMP MAIN

	CSEG AT 0050H

MAIN:
	CALL LOCKED
	CALL CHECK_PASS
	CALL OPEN
	
LOCKED:
	SETB BL_TEN
	MOV STATE, #STATE_L
	MOV N_STATE, #STATE_0
	MOV A, STATE
	CALL UPDATE_DISP
	CALL PASS_INPUT
	RET
	
CHECK_PASS:
	MOV A, DIGIT_1
	CALL DECRYPT
	MOV DIGIT_1, A
	MOV A, SEC_DIGIT_1
	CALL DECRYPT
	CJNE A, DIGIT_1, FAIL
	MOV A, DIGIT_2
	CALL DECRYPT
	MOV DIGIT_2, A
	MOV A, SEC_DIGIT_2
	CALL DECRYPT
	CJNE A, DIGIT_2, FAIL
	MOV A, DIGIT_3
	CALL DECRYPT
	MOV DIGIT_3, A
	MOV A, SEC_DIGIT_3
	CALL DECRYPT
	CJNE A, DIGIT_3, FAIL
	MOV A, DIGIT_4
	CALL DECRYPT
	MOV DIGIT_4, A
	MOV A, SEC_DIGIT_4
	CALL DECRYPT
	CJNE A,DIGIT_4, FAIL
	RET

FAIL:
	MOV STATE, #STATE_F
	MOV N_STATE, #STATE_L
	MOV A, STATE
	CALL UPDATE_DISP
	MOV A, R5
	MOV R6, A
	CALL FAIL_DELAY
	ADD A, #3CH
	MOV R5, A
	DJNZ R1, MAIN
	CALL BLOCKED
	
FAIL_DELAY:
	JNB TF2H, FAIL_DELAY
		CLR TF2H
		DJNZ R0, FAIL_DELAY
			MOV R0, #MUL_CLK
	DJNZ R6, FAIL_DELAY
	RET
		
BLOCKED:
	MOV STATE, #STATE_B
	MOV N_STATE, #STATE_L
	MOV A, STATE
	CALL UPDATE_DISP
	CALL ALARMS

ALARMS:
	JNB TF2H, ALARMS
		CLR TF2H
		DJNZ R0, ALARMS
			CPL ALARM		; COMUTES THE BIT 7 OF THE P2 PORT
			MOV R0, #MUL_CLK
	SJMP ALARMS

OPEN:
	CLR BL_TEN
	MOV STATE, #STATE_O
	MOV N_STATE, #STATE_0
	MOV A, STATE
	CALL UPDATE_DISP
	CALL CHECK_OPEN

CHECK_OPEN:
	JNB TF2H, CHECK_OPEN
		CLR TF2H
		DJNZ R0, CHECK_OPEN
			CPL P2.7		; COMUTES THE BIT 7 OF THE P2 PORT
			MOV R0, #MUL_CLK
	JB K_LOAD, CHECK_NEW_PASS
	JNB K_LOAD, $
	JMP MAIN

CHECK_NEW_PASS:
	JB K_SET, CONTROL_LOOP
	JNB K_SET, $
	CALL NEW_PASS

CONTROL_LOOP:
	DJNZ R7, CHECK_OPEN
	CALL NEW_PASS
	
NEW_PASS:
	MOV STATE, #STATE_0
	MOV N_STATE, #STATE_1
	MOV A, STATE
	CALL UPDATE_DISP
	JB K_SET, $
	JNB K_SET, $
	CALL PASS_INPUT
	MOV SEC_DIGIT_1, DIGIT_1
	MOV SEC_DIGIT_2, DIGIT_2
	MOV SEC_DIGIT_3, DIGIT_3
	MOV SEC_DIGIT_4, DIGIT_4
	JMP MAIN

PASS_INPUT:
	CALL DISPLAY
	MOV A, STATE
	CALL ENCRYPT
	MOV DIGIT_1, A
	MOV STATE, #STATE_0
	MOV N_STATE, #STATE_1
	MOV A, STATE
	CALL UPDATE_DISP
	CALL DISPLAY
	MOV A, STATE
	CALL ENCRYPT
	MOV DIGIT_2, A
	MOV STATE, #STATE_0
	MOV N_STATE, #STATE_1
	MOV A, STATE
	CALL UPDATE_DISP
	CALL DISPLAY
	MOV A, STATE
	CALL ENCRYPT
	MOV DIGIT_3, A
	MOV STATE, #STATE_0
	MOV N_STATE, #STATE_1
	MOV A, STATE
	CALL UPDATE_DISP
	CALL DISPLAY
	MOV A, STATE
	CALL ENCRYPT
	MOV DIGIT_4, A
	RET
	
DISPLAY:
	CALL CHECK_K_LOAD
	RET

CHECK_K_SET:
	JB K_SET, CHECK_K_LOAD
	JNB K_SET, $
	MOV STATE, N_STATE
	CALL ENCODE_FSM
	MOV A, STATE
	CALL UPDATE_DISP

CHECK_K_LOAD: 
	JB K_LOAD, CHECK_K_SET
	JNB K_LOAD, $
	RET

ENCRYPT:
	RL A
	RET

DECRYPT:
	RR A
	RET
	
UPDATE_DISP:
	;USES THE ACC AS AN OFFSET
	MOV DPTR, #ARRAY
	MOVC A, @A+DPTR
	MOV P_DISP, A	
	RET
	
ENCODE_FSM:
	MOV DPTR, #TABLA
	MOV A, STATE
	RL A
	JMP @A+DPTR

TABLA:
	AJMP	CODE_STATE_0
	AJMP	CODE_STATE_1
	AJMP	CODE_STATE_2
	AJMP	CODE_STATE_3
	AJMP	CODE_STATE_4
	AJMP	CODE_STATE_5
	AJMP	CODE_STATE_6
	AJMP	CODE_STATE_7
	AJMP 	CODE_STATE_8
	AJMP 	CODE_STATE_9
	AJMP	CODE_STATE_L
	AJMP	CODE_STATE_O
	AJMP 	CODE_STATE_F

CODE_STATE_0:
	MOV N_STATE, #STATE_1
	RET
	
CODE_STATE_1:
	MOV N_STATE, #STATE_2
	RET	
	
CODE_STATE_2:
	MOV N_STATE, #STATE_3
	RET
	
CODE_STATE_3:
	MOV N_STATE, #STATE_4
	RET

CODE_STATE_4:
	MOV N_STATE, #STATE_5
	RET

CODE_STATE_5:
	MOV N_STATE, #STATE_6
	RET

CODE_STATE_6:
	MOV N_STATE, #STATE_7
	RET

CODE_STATE_7:
	MOV N_STATE, #STATE_8
	RET
	
CODE_STATE_8:
	MOV N_STATE, #STATE_9
	RET
	
CODE_STATE_9:
	MOV N_STATE, #STATE_0
	RET
	
CODE_STATE_L:
	MOV N_STATE, #STATE_0
	RET

CODE_STATE_O:
	MOV N_STATE, #STATE_0
	RET

CODE_STATE_F:
	MOV N_STATE, #STATE_L
	RET
	
CODE_STATE_B:
	MOV N_STATE, #STATE_L
	RET
	
ARRAY:
	; HEX VALUES FOR DISPLAYING IN THE 7SEGMENTS DISPLAY 0-9 THAN  L,O,F,B
	DB 0C0H, 0F9H, 0A4H, 0B0H, 099H, 092H, 082H, 0F8H, 080H, 090H, 0C7H, 0A3H, 08EH, 083H
		
END
